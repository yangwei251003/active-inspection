## firmware/companion/c6/sdkconfig.defaults
```kconfig
# Waveshare ESP32-P4-NANO ESP32-C6-MINI-1-N4, offline document-backed profile.
# Based on ESP-Hosted 2.12.13 slave defaults; board must be verified before flashing.
# SDIO GPIO numbers below are C6 GPIOs, not P4 GPIOs.
CONFIG_BT_ENABLED=y
CONFIG_BT_CONTROLLER_ONLY=y
CONFIG_ESPTOOLPY_FLASHSIZE_4MB=y
CONFIG_FREERTOS_HZ=1000
CONFIG_ESP_WIFI_NVS_ENABLED=y
CONFIG_BOOTLOADER_COMPILER_OPTIMIZATION_PERF=y
CONFIG_ESP_WIFI_ENTERPRISE_SUPPORT=n
CONFIG_ESP_DEFAULT_CPU_FREQ_MHZ_160=y
CONFIG_BT_BLUEDROID_ENABLED=n
CONFIG_BT_LE_SLEEP_ENABLE=y
CONFIG_BT_LE_HCI_INTERFACE_USE_RAM=y
CONFIG_PARTITION_TABLE_CUSTOM=y
CONFIG_PARTITION_TABLE_CUSTOM_FILENAME="partitions.esp32c6.csv"
CONFIG_WIFI_CMD_BASIC_ONLY=y
CONFIG_ESP_WIFI_STATIC_RX_BUFFER_NUM=10
CONFIG_ESP_WIFI_DYNAMIC_RX_BUFFER_NUM=32
CONFIG_ESP_WIFI_DYNAMIC_TX_BUFFER_NUM=32
CONFIG_ESP_WIFI_AMPDU_TX_ENABLED=y
CONFIG_ESP_WIFI_TX_BA_WIN=32
CONFIG_ESP_WIFI_AMPDU_RX_ENABLED=y
CONFIG_ESP_WIFI_RX_BA_WIN=6
CONFIG_ESP_WIFI_RX_IRAM_OPT=y
CONFIG_ESP_WIFI_IRAM_OPT=y
CONFIG_LWIP_TCP_SND_BUF_DEFAULT=11520
CONFIG_LWIP_TCP_WND_DEFAULT=11520
CONFIG_LWIP_TCP_RECVMBOX_SIZE=16
CONFIG_LWIP_UDP_RECVMBOX_SIZE=16
CONFIG_LWIP_TCPIP_RECVMBOX_SIZE=32
CONFIG_LWIP_TCP_SACK_OUT=y
CONFIG_LWIP_TCPIP_CORE_LOCKING=y
CONFIG_LWIP_TCPIP_CORE_LOCKING_INPUT=y
CONFIG_COMPILER_OPTIMIZATION_PERF=y
CONFIG_ESP_HOST_DEV_BOARD_NONE=y
CONFIG_ESP_SDIO_HOST_INTERFACE=y
CONFIG_ESP_SDIO_GPIO_RESET=-1
CONFIG_ESP_SDIO_PIN_CLK=19
CONFIG_ESP_SDIO_PIN_CMD=18
CONFIG_ESP_SDIO_PIN_D0=20
CONFIG_ESP_SDIO_PIN_D1=21
CONFIG_ESP_SDIO_PIN_D2=22
CONFIG_ESP_SDIO_PIN_D3=23
CONFIG_ESP_SDIO_HIGH_SPEED=y
CONFIG_ESP_HOSTED_CP_WIFI=y
CONFIG_ESP_HOSTED_CP_BT=y
CONFIG_ESP_HOSTED_COPROCESSOR_APP_MAIN=y
CONFIG_ESP_COEX_SW_COEXIST_ENABLE=y
CONFIG_ESP_HOSTED_NETWORK_SPLIT_ENABLED=n
CONFIG_ESP_HOSTED_HOST_POWER_SAVE_ENABLED=n
CONFIG_ESP_HOSTED_OT_RCP_ENABLED=n
CONFIG_ESPTOOLPY_FLASHMODE_DIO=y
CONFIG_ESPTOOLPY_FLASHFREQ_80M=y
CONFIG_ESP_HOSTED_ENABLE_GPIO_EXPANDER=n
```

## firmware/companion/main/Kconfig.projbuild
```kconfig
menu "Active inspection (hardware unverified)"
config AI_DEVICE_ID
    string "Device ID"
    default "inspection-01"
config AI_WS_URL
    string "Authenticated WSS URL (blank disables cloud)"
    default ""
config AI_DEVICE_TOKEN
    string "Device token (private local sdkconfig only)"
    default ""
config AI_WHIP_URL
    string "HTTPS WHIP URL (blank disables media publishing)"
    default ""
config AI_UART_TX
    int "Reference STM32 UART TX GPIO (verify board first)"
    default 20
config AI_UART_RX
    int "Reference STM32 UART RX GPIO (verify board first)"
    default 21
config AI_UART_ENABLE
    bool "Enable STM32 UART after board verification"
    default n
config AI_MEDIA_ENABLE
    bool "Enable OV5647 capture and WebRTC"
    default y
config AI_BLE_ENABLE
    bool "Enable temporary BLE maintenance service"
    default y
config AI_PAIRING_BUTTON
    int "BOOT button GPIO (active low; verify delivered board)"
    default 35
endmenu
```

## firmware/companion/sdkconfig.defaults
```kconfig
CONFIG_IDF_TARGET="esp32p4"
CONFIG_ESP32P4_REV_MIN_300=y
CONFIG_ESPTOOLPY_FLASHSIZE_16MB=y
CONFIG_ESPTOOLPY_FLASHMODE_QIO=y
CONFIG_BOOTLOADER_LOG_LEVEL_WARN=y
CONFIG_COMPILER_OPTIMIZATION_PERF=y
CONFIG_SPIRAM=y
CONFIG_SPIRAM_SPEED_200M=y
CONFIG_SPIRAM_TRY_ALLOCATE_WIFI_LWIP=y
CONFIG_MBEDTLS_EXTERNAL_MEM_ALLOC=y
CONFIG_MBEDTLS_CERTIFICATE_BUNDLE=y
CONFIG_MBEDTLS_SSL_PROTO_DTLS=y
CONFIG_MBEDTLS_SSL_DTLS_SRTP=y
CONFIG_MBEDTLS_X509_CREATE_C=y
CONFIG_ESP_CONSOLE_USB_SERIAL_JTAG=y
CONFIG_ESP_MAIN_TASK_STACK_SIZE=12288
CONFIG_FREERTOS_HZ=1000
CONFIG_PARTITION_TABLE_CUSTOM=y
CONFIG_PARTITION_TABLE_CUSTOM_FILENAME="partitions.csv"
CONFIG_PARTITION_TABLE_OFFSET=0x9000
CONFIG_CAMERA_OV5647=y
CONFIG_CAMERA_OV5647_AUTO_DETECT_MIPI_INTERFACE_SENSOR=y
CONFIG_CAMERA_OV5647_MIPI_RAW8_800X800_50FPS=n
CONFIG_CAMERA_OV5647_MIPI_RAW10_1920X1080_30FPS=y
CONFIG_CAMERA_OV5647_MIPI_DEFAULT_FMT_RAW10_1920X1080_30FPS=y
CONFIG_ESP_VIDEO_ENABLE_ISP_PIPELINE_CONTROLLER=y
CONFIG_ESP_VIDEO_ENABLE_MIPI_CSI_VIDEO_DEVICE=y
CONFIG_BT_ENABLED=y
CONFIG_BT_NIMBLE_ENABLED=y
CONFIG_BT_CONTROLLER_DISABLED=y
CONFIG_BT_NIMBLE_TRANSPORT_UART=n
CONFIG_ESP_WIFI_REMOTE_ENABLED=y
CONFIG_ESP_WIFI_REMOTE_LIBRARY_HOSTED=y
CONFIG_SLAVE_IDF_TARGET_ESP32C6=y
CONFIG_ESP_HOSTED_ENABLE_BT_NIMBLE=y
CONFIG_ESP_HOSTED_CP_TARGET_ESP32C6=y
CONFIG_ESP_HOSTED_SDIO_HOST_INTERFACE=y
CONFIG_ESP_HOSTED_SDIO_PIN_CMD=19
CONFIG_ESP_HOSTED_SDIO_PIN_CLK=18
CONFIG_ESP_HOSTED_SDIO_PIN_D0=14
CONFIG_ESP_HOSTED_SDIO_PIN_D1=15
CONFIG_ESP_HOSTED_SDIO_PIN_D2=16
CONFIG_ESP_HOSTED_SDIO_PIN_D3=17
CONFIG_ESP_HOSTED_SDIO_GPIO_RESET_SLAVE=54
CONFIG_LWIP_MAX_SOCKETS=16
CONFIG_LWIP_TCPIP_RECVMBOX_SIZE=64
CONFIG_AI_UART_ENABLE=n
```
